## Project_Secure_IoT_Gateway_with_Yocto/poky/build/conf/bblayers.conf
```bitbake
# POKY_BBLAYERS_CONF_VERSION is increased each time build/conf/bblayers.conf
# changes incompatibly
POKY_BBLAYERS_CONF_VERSION = "2"

BBPATH = "${TOPDIR}"
BBFILES ?= ""

BBLAYERS ?= " \
  /media/ragab/2e6aa1be-2f37-440f-9a02-a6118b45e071/yocto_image/poky/meta \
  /media/ragab/2e6aa1be-2f37-440f-9a02-a6118b45e071/yocto_image/poky/meta-poky \
  /media/ragab/2e6aa1be-2f37-440f-9a02-a6118b45e071/yocto_image/poky/meta-yocto-bsp \
  /media/ragab/2e6aa1be-2f37-440f-9a02-a6118b45e071/yocto_image/poky/meta-raspberrypi \
  /media/ragab/2e6aa1be-2f37-440f-9a02-a6118b45e071/yocto_image/poky/meta-iotgateway \
  /media/ragab/2e6aa1be-2f37-440f-9a02-a6118b45e071/yocto_image/poky/meta-openembedded/meta-oe \
  /media/ragab/2e6aa1be-2f37-440f-9a02-a6118b45e071/yocto_image/poky/meta-openembedded/meta-python \
  /media/ragab/2e6aa1be-2f37-440f-9a02-a6118b45e071/yocto_image/poky/meta-openembedded/meta-networking \
  /media/ragab/2e6aa1be-2f37-440f-9a02-a6118b45e071/yocto_image/poky/meta-openembedded/meta-multimedia \
  /media/ragab/2e6aa1be-2f37-440f-9a02-a6118b45e071/yocto_image/poky/meta-openembedded/meta-gnome \
  /media/ragab/2e6aa1be-2f37-440f-9a02-a6118b45e071/yocto_image/poky/meta-qt5 \
  /media/ragab/2e6aa1be-2f37-440f-9a02-a6118b45e071/yocto_image/poky/build/workspace \
  "
```
